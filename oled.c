#include "oled.h"

#include <string.h>
extern I2C_HandleTypeDef hi2c1;

/* 7-bit??0x3C ??1???HAL????0x78 */
#define OLED_ADDR  0x78

const uint8_t zh16x16[][36] = {
/* 0 bi */ {0xe6,0xaf,0x95,0x00,0xff,0xfb,0xff,0xfb,0x00,0xfa,0x77,0xfb,0x77,0xfb,0xb7,0xfb,0xb7,0xfb,0xff,0x00,0x80,0xfb,0x77,0xfb,0x7b,0xfb,0x7b,0xfb,0x7d,0xfb,0x1f,0xfb,0xff,0xfb,0xff,0xff,},
/* 1 she */ {0xe8,0xae,0xbe,0x00,0xbf,0xff,0xbf,0xff,0xbd,0xff,0x33,0xc0,0xff,0x6f,0xbf,0x77,0x5f,0xbf,0x61,0xbc,0x7d,0xd3,0x7d,0xef,0x7d,0xd7,0x61,0xb9,0x5f,0xbe,0xdf,0x7f,0xdf,0x7f,0xff,0xff,},
/* 2 zuo */ {0xe4,0xbd,0x9c,0x00,0xff,0xfe,0x7f,0xff,0x9f,0xff,0x07,0x00,0xf8,0xff,0xbf,0xff,0xcf,0xff,0xf0,0xff,0x07,0x00,0x77,0xf7,0x77,0xf7,0x77,0xf7,0x77,0xf7,0xf7,0xf7,0xf7,0xff,0xff,0xff,},
/* 3 pin */ {0xe5,0x93,0x81,0x00,0xff,0xff,0xff,0x01,0xff,0xbd,0x81,0xbd,0xbd,0xbd,0xbd,0x01,0xbd,0xff,0xbd,0xff,0xbd,0xff,0xbd,0x01,0xbd,0xbd,0x81,0xbd,0xff,0xbd,0xff,0x01,0xff,0xff,0xff,0xff,},
/* 4 : */ {0xef,0xbc,0x9a,0x00,0xff,0xff,0xff,0xff,0xff,0xff,0xff,0xff,0xff,0xff,0xff,0xff,0xff,0xff,0xcf,0xf3,0xcf,0xf3,0xff,0xff,0xff,0xff,0xff,0xff,0xff,0xff,0xff,0xff,0xff,0xff,0xff,0xff,},
/* 5 gong */ {0xe9,0xbe,0x9a,0x00,0x7f,0xef,0x7b,0xef,0xbb,0x6d,0xdb,0xad,0xe3,0xcd,0x58,0xe0,0xdb,0xed,0xc3,0xed,0xab,0xed,0x2b,0xe0,0xb2,0xcd,0xb9,0xad,0xbb,0x6d,0x8b,0xef,0xff,0xef,0xff,0xff,},
/* 6 jia */ {0xe4,0xbd,0xb3,0x00,0xff,0xfe,0x7f,0xff,0x9f,0xff,0x07,0x00,0xb8,0xbf,0xbf,0xbf,0xbb,0xbb,0xbb,0xbb,0xbb,0xbb,0x80,0x80,0xbb,0xbb,0xbb,0xbb,0xbb,0xbb,0xbb,0xbb,0xbf,0xbf,0xff,0xff,},
/* 7 qi */ {0xe7,0x90,0xa6,0x00,0x7b,0xef,0x7b,0xcf,0x03,0xe0,0x7b,0xf7,0x7b,0xf7,0xbf,0xff,0x9b,0xe0,0xab,0xee,0xb3,0xee,0xb8,0xe0,0xb3,0xbf,0xab,0x7f,0x1b,0x80,0xbb,0xff,0xbf,0xff,0xff,0xff,},
/* 8 gan */ {0xe6,0x84,0x9f,0x00,0xff,0x77,0xff,0x99,0x03,0xfe,0xfb,0xff,0x2b,0x9c,0xab,0x7d,0xab,0x7d,0xab,0x6d,0x2b,0x54,0xfb,0x7b,0x80,0x7d,0x7b,0x3e,0x3a,0xfd,0xc9,0xdb,0xfb,0x30,0xff,0xff,},
/* 9 xie */ {0xe8,0xb0,0xa2,0x00,0xbf,0xff,0xbd,0xff,0x33,0xc0,0xff,0xef,0xff,0xd5,0x03,0xec,0xa9,0xb5,0xaa,0x79,0x03,0x80,0x7f,0xff,0xef,0xbc,0xef,0x7f,0x00,0x80,0xef,0xff,0xef,0xff,0xff,0xff,},
/* 10 guan */ {0xe8,0xa7,0x82,0x00,0xf7,0xdf,0xb7,0xef,0x77,0xf3,0xf7,0xfc,0x37,0xfb,0xc7,0x67,0xff,0xbf,0x01,0xdc,0xfd,0xe7,0xfd,0xf9,0x0d,0xfe,0xfd,0x81,0xfd,0x7f,0x01,0x7c,0xff,0x1f,0xff,0xff,},
/* 11 kan */ {0xe7,0x9c,0x8b,0x00,0xdf,0xf7,0xdd,0xfb,0xd5,0xfd,0xd5,0xfe,0x55,0x00,0x95,0xaa,0xc5,0xaa,0xd1,0xaa,0xd6,0xaa,0xd6,0xaa,0xd6,0xaa,0xd6,0x00,0xd6,0xff,0xdf,0xff,0xdf,0xff,0xff,0xff,},

	
/* 12 jia */ {0xe5,0x8a,0xa0,0x00,0xef,0x7f,0xef,0xbf,0xef,0xcf,0x00,0xf0,0xef,0xbf,0xef,0x7f,0x0f,0x80,0xff,0xff,0xff,0xff,0x07,0x80,0xf7,0xdf,0xf7,0xdf,0xf7,0xdf,0x07,0x80,0xff,0xff,0xff,0xff,},
/* 13 you */ {0xe6,0xb2,0xb9,0x00,0xef,0xfb,0x9f,0xfb,0xfd,0x81,0x73,0xfe,0xff,0xff,0x0f,0x00,0xef,0xbd,0xef,0xbd,0xef,0xbd,0x00,0x80,0xef,0xbd,0xef,0xbd,0xef,0xbd,0x0f,0x00,0xff,0xff,0xff,0xff,},
/* 14 , */ {0xef,0xbc,0x8c,0x00,0xff,0xff,0xff,0xff,0xff,0xff,0xff,0xd3,0xff,0xe3,0xff,0xff,0xff,0xff,0xff,0xff,0xff,0xff,0xff,0xff,0xff,0xff,0xff,0xff,0xff,0xff,0xff,0xff,0xff,0xff,0xff,0xff,},
/* 15 ni */ {0xe4,0xbd,0xa0,0x00,0xff,0xfe,0x7f,0xff,0x9f,0xff,0x07,0x00,0xf8,0xff,0xbf,0xef,0xdf,0xf3,0xe7,0xfc,0xf0,0xbf,0xf7,0x7f,0x37,0x80,0xf7,0xff,0xf7,0xfe,0xd7,0xf9,0xe7,0xe7,0xff,0xff,},
/* 16 shi */ {0xe6,0x98,0xaf,0x00,0xff,0x7e,0xff,0xbe,0xff,0xde,0x80,0xe2,0xb6,0xde,0xb6,0xbe,0xb6,0x7e,0xb6,0x00,0xb6,0x76,0xb6,0x76,0xb6,0x76,0x80,0x76,0xff,0x76,0xff,0x7e,0xff,0x7e,0xff,0xff,},
/* 17 zui */ {0xe6,0x9c,0x80,0x00,0xbf,0xdf,0xbf,0x9f,0x3f,0xc0,0xa0,0xda,0xaa,0xea,0xaa,0xea,0x2a,0x00,0xaa,0x6f,0xaa,0xb8,0xaa,0xd6,0xaa,0xee,0xa0,0xd2,0xbf,0xbc,0xbf,0x7f,0xbf,0x7f,0xff,0xff,},
/* 18 bnag */ {0xe6,0xa3,0x92,0x00,0xef,0xfb,0xef,0xfc,0x2f,0xff,0x00,0x00,0x6f,0xff,0xef,0xfe,0xbb,0xed,0xab,0xee,0x2b,0xeb,0x8b,0xeb,0xa0,0x00,0xab,0xeb,0x2b,0xeb,0xab,0xee,0xbb,0xed,0xff,0xff,},
/* 19 de */ {0xe7,0x9a,0x84,0x00,0xff,0xff,0x07,0x80,0xf3,0xde,0xf4,0xde,0xf7,0xde,0xf7,0xde,0x07,0x80,0xbf,0xff,0xcf,0xff,0x70,0xff,0xf7,0xbc,0xf7,0x7f,0xf7,0xbf,0x07,0xc0,0xff,0xff,0xff,0xff,},
/* 20 ! */ {0xef,0xbc,0x81,0x00,0xff,0xff,0xff,0xff,0xff,0xff,0xff,0xff,0xff,0xff,0x83,0xef,0x01,0xc4,0x83,0xef,0xff,0xff,0xff,0xff,0xff,0xff,0xff,0xff,0xff,0xff,0xff,0xff,0xff,0xff,0xff,0xff,}
};

static const uint8_t OLED_F6x8[][6] =
{
    /* ' ' */ {0x00,0x00,0x00,0x00,0x00,0x00},

    /* H */   {0x7F,0x08,0x08,0x08,0x7F,0x00},
    /* e */   {0x38,0x54,0x54,0x54,0x18,0x00},
    /* l */   {0x00,0x41,0x7F,0x40,0x00,0x00},
    /* o */   {0x38,0x44,0x44,0x44,0x38,0x00},

    /* A */   {0x7E,0x11,0x11,0x11,0x7E,0x00},
    /* D */   {0x7F,0x41,0x41,0x22,0x1C,0x00},
    /* C */   {0x3E,0x41,0x41,0x41,0x22,0x00},
    /* : */   {0x00,0x36,0x36,0x00,0x00,0x00},

    /* 0 */   {0x3E,0x51,0x49,0x45,0x3E,0x00},
    /* 1 */   {0x00,0x42,0x7F,0x40,0x00,0x00},
    /* 2 */   {0x42,0x61,0x51,0x49,0x46,0x00},
    /* 3 */   {0x21,0x41,0x45,0x4B,0x31,0x00},
    /* 4 */   {0x18,0x14,0x12,0x7F,0x10,0x00},
    /* 5 */   {0x27,0x45,0x45,0x45,0x39,0x00},
    /* 6 */   {0x3C,0x4A,0x49,0x49,0x30,0x00},
    /* 7 */   {0x01,0x71,0x09,0x05,0x03,0x00},
    /* 8 */   {0x36,0x49,0x49,0x49,0x36,0x00},
    /* 9 */   {0x06,0x49,0x49,0x29,0x1E,0x00},
		
		/* P */   {0x7F,0x09,0x09,0x09,0x06,0x00},
    /* L */   {0x7F,0x40,0x40,0x40,0x40,0x00},
    /* i */   {0x00,0x44,0x7D,0x40,0x00,0x00},
    /* g */   {0x18,0xA4,0xA4,0xA4,0x7C,0x00},
    /* h */   {0x7F,0x08,0x04,0x04,0x78,0x00},
    /* t */   {0x04,0x3F,0x44,0x40,0x20,0x00},
		
		/* W */   {0x7F,0x20,0x18,0x20,0x7F,0x00},
		/* c */   {0x38,0x44,0x44,0x44,0x20,0x00},
		/* m */   {0x7C,0x04,0x18,0x04,0x78,0x00},
		
		/* , */	 	{0x00,0x50,0x30,0x00,0x00,0x00},
		
		/* T */   {0x01,0x01,0x7F,0x01,0x01,0x00},
		/* p */   {0xFC,0x24,0x24,0x24,0x18,0x00},
		
		/* / */   {0x40,0x30,0x0C,0x03,0x00,0x00}


		
		
};
static void OLED_WriteCommand(uint8_t cmd)
{
    uint8_t data[2];
    data[0] = 0x00;   // ????:??
    data[1] = cmd;
    HAL_I2C_Master_Transmit(&hi2c1, OLED_ADDR, data, 2, 100);
}

static void OLED_WriteData(uint8_t *data, uint16_t size)
{
    uint8_t buf[129];
    uint16_t i;

    buf[0] = 0x40;    // ????:??
    for (i = 0; i < size; i++)
    {
        buf[i + 1] = data[i];
    }
    HAL_I2C_Master_Transmit(&hi2c1, OLED_ADDR, buf, size + 1, 100);
}

static void OLED_SetCursor(uint8_t page, uint8_t x)
{
    OLED_WriteCommand(0xB0 + page);
    OLED_WriteCommand(0x10 | ((x & 0xF0) >> 4));
    OLED_WriteCommand(0x00 | (x & 0x0F));
}

void OLED_Clear(void)
{
    uint8_t i, j;
    uint8_t zero[128];

    for (j = 0; j < 128; j++) zero[j] = 0x00;

    for (i = 0; i < 8; i++)
    {
        OLED_SetCursor(i, 0);
        OLED_WriteData(zero, 128);
    }
}

void OLED_Init(void)
{
    HAL_Delay(100);

    OLED_WriteCommand(0xAE); // display off
    OLED_WriteCommand(0x20); // Set Memory Addressing Mode
    OLED_WriteCommand(0x10); // Page addressing mode
    OLED_WriteCommand(0xB0); // Page Start Address
    OLED_WriteCommand(0xC8); // COM Output Scan Direction
    OLED_WriteCommand(0x00); // low column
    OLED_WriteCommand(0x10); // high column
    OLED_WriteCommand(0x40); // start line
    OLED_WriteCommand(0x81); // contrast
    OLED_WriteCommand(0x7F);
    OLED_WriteCommand(0xA1); // segment remap
    OLED_WriteCommand(0xA6); // normal display
    OLED_WriteCommand(0xA8); // multiplex ratio
    OLED_WriteCommand(0x3F);
    OLED_WriteCommand(0xA4); // display follows RAM
    OLED_WriteCommand(0xD3); // display offset
    OLED_WriteCommand(0x00);
    OLED_WriteCommand(0xD5); // osc frequency
    OLED_WriteCommand(0xF0);
    OLED_WriteCommand(0xD9); // pre-charge period
    OLED_WriteCommand(0x22);
    OLED_WriteCommand(0xDA); // com pins config
    OLED_WriteCommand(0x12);
    OLED_WriteCommand(0xDB); // vcomh
    OLED_WriteCommand(0x20);
    OLED_WriteCommand(0x8D); // charge pump
    OLED_WriteCommand(0x14);
    OLED_WriteCommand(0xAF); // display on

    OLED_Clear();
}

void OLED_ShowChar(uint8_t x, uint8_t y, char chr)
{
    uint8_t index;

    switch (chr)
    {
			case ' ': index = 0; break;

			case 'H': index = 1; break;
			case 'e': index = 2; break;
			case 'l': index = 3; break;
			case 'o': index = 4; break;

			case 'A': index = 5; break;
			case 'D': index = 6; break;
			case 'C': index = 7; break;
			case ':': index = 8; break;

			case '0': index = 9;  break;
			case '1': index = 10; break;
			case '2': index = 11; break;
			case '3': index = 12; break;
			case '4': index = 13; break;
			case '5': index = 14; break;
			case '6': index = 15; break;
			case '7': index = 16; break;
			case '8': index = 17; break;
			case '9': index = 18; break;
			
			case 'P': index = 19; break;
			case 'L': index = 20; break;
			case 'i': index = 21; break;
			case 'g': index = 22; break;
			case 'h': index = 23; break;
			case 't': index = 24; break;
			
			case 'W': index = 25; break;
			case 'c': index = 26; break;
			case 'm': index = 27; break;
			
			case ',': index = 28; break;
			
			case 'T': index = 29; break;
			case 'p': index = 30; break;
			
			case '/': index = 31; break;


			default:  index = 0; break;
    }

    OLED_SetCursor(y - 1, x - 1);
    OLED_WriteData((uint8_t *)&OLED_F6x8[index][0], 6);
}

void OLED_ShowString(uint8_t x, uint8_t y, char *str)
{
    while (*str != '\0')
    {
        OLED_ShowChar(x, y, *str);
        x += 6;   
        str++;
    }
}

void OLED_ShowChinese16(uint8_t x, uint8_t y, uint8_t index)
{
    uint8_t upper[16] = {0};
    uint8_t lower[16] = {0};
    uint8_t row, col;
    uint16_t row_data;

    for (row = 0; row < 16; row++)
    {
        row_data = (uint16_t)zh16x16[index][4 + row * 2]
                 | ((uint16_t)zh16x16[index][5 + row * 2] << 8);

        row_data = ~row_data;

        for (col = 0; col < 16; col++)
        {
            if (row_data & (1 << col))
            {
                if (col < 8)
                {
                    upper[row] |= (1 << col);
                }
                else
                {
                    lower[row] |= (1 << (col - 8));
                }
            }
        }
    }

    OLED_SetCursor(y - 1, x - 1);
    OLED_WriteData(upper, 16);

    OLED_SetCursor(y, x - 1);
    OLED_WriteData(lower, 16);
}


void OLED_ShowStringCenter(uint8_t y, char *str)
{
    uint8_t len = 0;
    uint8_t x;

    while (str[len] != '\0')
    { 
        len++;
    }

    x = (128 - len * 6) / 2 + 1;
    OLED_ShowString(x, y, str);
}

void OLED_ShowChineseCenter16(uint8_t y, uint8_t start_index, uint8_t count)
{
    uint8_t i;
    uint8_t x;

    x = (128 - count * 16) / 2 + 1;

    for (i = 0; i < count; i++)
    {
        OLED_ShowChinese16(x + i * 16, y, start_index + i);
    }
}

void OLED_ShowBMP(uint8_t x, uint8_t y, uint8_t w, uint8_t h, const uint8_t *bmp)
{
    uint8_t page, row, col;
    uint8_t pages = h / 8;
    uint8_t line[128];
    uint16_t bytes_per_row = w / 8;

    for (page = 0; page < pages; page++)
    {
        for (col = 0; col < w; col++)
        {
            line[col] = 0x00;
        }

        for (row = 0; row < 8; row++)
        {
            uint8_t src_y = page * 8 + row;

            for (col = 0; col < w; col++)
            {
                uint16_t byte_index = src_y * bytes_per_row + (col / 8);
                uint8_t byte_data = bmp[byte_index];

              
                uint8_t pixel = (byte_data >> (col % 8)) & 0x01;

                if (pixel)
                {
                    line[col] |= (1 << row);
                }
            }
        }

        OLED_SetCursor((y - 1) + page, x - 1);
        OLED_WriteData(line, w);
    }
}


void OLED_ClearArea(uint8_t x, uint8_t y, uint8_t w, uint8_t h)
{
    uint8_t page;
    uint8_t pages = h / 8;
    uint8_t zero[128];
    uint8_t i;

    for (i = 0; i < 128; i++)
    {
        zero[i] = 0x00;
    }

    for (page = 0; page < pages; page++)
    {
        OLED_SetCursor((y - 1) + page, x - 1);
        OLED_WriteData(zero, w);
    }
}

void OLED_ShowChinese16Clip(int16_t x, uint8_t y, uint8_t index)
{
    uint8_t upper[16] = {0};
    uint8_t lower[16] = {0};
    uint8_t row, col;
    uint16_t row_data;
    int16_t start, end;
    uint8_t draw_x;

    for (row = 0; row < 16; row++)
    {
        row_data = (uint16_t)zh16x16[index][4 + row * 2]
                 | ((uint16_t)zh16x16[index][5 + row * 2] << 8);

        row_data = ~row_data;

        for (col = 0; col < 16; col++)
        {
            if (row_data & (1 << col))
            {
                if (col < 8)
                {
                    upper[row] |= (1 << col);
                }
                else
                {
                    lower[row] |= (1 << (col - 8));
                }
            }
        }
    }

    if (x <= -16 || x >= 128)
    {
        return;
    }

    start = 0;
    end = 16;

    if (x < 0)
    {
        start = -x;
    }

    if (x + 16 > 128)
    {
        end = 128 - x;
    }

    if (start >= end)
    {
        return;
    }

    draw_x = (x < 0) ? 0 : (uint8_t)x;

    OLED_SetCursor(y - 1, draw_x);
    OLED_WriteData(&upper[start], end - start);

    OLED_SetCursor(y, draw_x);
    OLED_WriteData(&lower[start], end - start);
}

